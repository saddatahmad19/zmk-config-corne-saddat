/*
 * Copyright (c) 2020 The ZMK Contributors
 *
 * SPDX-License-Identifier: MIT
 */

#include <behaviors.dtsi>
#include <dt-bindings/zmk/keys.h>
#include <dt-bindings/zmk/bt.h>

&gqtl:

global-quick-tap-layer {
    compatible = "zmk,behavior-hold-tap";
    label = "GLOBAL_QUICK_TAP";
    #binding-cells = <2>;
    flavor = "tap-preferred";
    tapping-term-ms = <200>;
    quick-tap-ms = <125>;
    global-quick-tap;
    bindings =
        <&mo>,
        <&kp>;
};

&mt {
    tapping-term-ms = <250>;
};

/ {
    keymap {
        compatible = "zmk,keymap";

        default_layer {
            // -----------------------------------------------------------------------------------------
            // |  TAB |  Q  |  W  |  E  |  R  |  T  |   |  Y  |  U   |  I  |  O  |  P  | BKSP |
            // | CTRL |  A  |  S  |  D  |  F  |  G  |   |  H  |  J   |  K  |  L  |  ;  |  '   |
            // | SHFT |  Z  |  X  |  C  |  V  |  B  |   |  N  |  M   |  ,  |  .  |  /  | ESC  |
            //                    | GUI | LWR | SPC |   | ENT | RSE  | ALT |

            bindings = <
 &kp ESC     &kp Q  &kp W     &kp E        &kp R      &kp T        &kp Y        &kp U     &kp I      &kp O     &kp P  &kp BSPC
 &kp TAB     &kp A  &kp S     &kp D        &kp F      &kp G        &kp H        &kp J     &kp K      &kp L  &kp APOS   &kp RET
&kp LGUI  &kp SEMI  &kp Z     &kp X        &kp C      &kp V        &kp B        &kp N     &kp M  &kp COMMA   &kp DOT  &kp FSLH
                           &kp LGUI  &mo LOWER 1  &kp SPACE    &kp SPACE  &mo RAISE 2  &kp RALT
            >;
        };

        lower_layer {
            // -----------------------------------------------------------------------------------------
            // |  TAB |  1  |  2  |  3  |  4  |  5  |   |  6  |  7  |  8  |  9  |  0  | BKSP |
            // | BTCLR| BT1 | BT2 | BT3 | BT4 | BT5 |   | LFT | DWN |  UP | RGT |     |      |
            // | SHFT |     |     |     |     |     |   |     |     |     |     |     |      |
            //                    | GUI |     | SPC |   | ENT |     | ALT |

            bindings = <
&kp ESC  &kp EXCL  &kp AT  &kp HASH  &kp DLLR  &kp PRCNT    &kp CARET   &kp AMPS  &kp KP_MULTIPLY  &kp LPAR   &kp RPAR  &kp BSPC
&bt TAB    &bt N1  &bt N2    &bt N3    &bt N4     &bt N5    &kp MINUS  &kp EQUAL         &kp LBKT  &kp RBKT   &kp NUBS   &kp RET
 &trans       &N6     &N7       &N8       &N9        &N0       &UNDER      &PLUS         &kp LBRC  &kp RBRC  &kp PIPE2    &trans
                           &kp LGUI    &trans  &kp LSHFT    &kp SPACE     &trans         &kp RALT
            >;
        };

        raise_layer {
            // -----------------------------------------------------------------------------------------
            // |  TAB |  !  |  @  |  #  |  $  |  %  |   |  ^  |  &  |  *  |  (  |  )  | BKSP |
            // | CTRL |     |     |     |     |     |   |  -  |  =  |  [  |  ]  |  \  |  `   |
            // | SHFT |     |     |     |     |     |   |  _  |  +  |  {  |  }  | "|" |  ~   |
            //                    | GUI |     | SPC |   | ENT |     | ALT |

            bindings = <
    &trans        &kp F1        &kp F2        &kp F3        &kp F4        &kp F5       &kp F6    &kp F7    &kp F8     &kp F9  &kp F10  &kp BSPC
&bt BT_CLR  &bt BT_SEL 1  &bt BT_SEL 2  &bt BT_SEL 3  &bt BT_SEL 4  &bt BT_SEL 5     &kp LEFT  &kp DOWN    &kp UP  &kp RIGHT   &trans    &trans
    &trans        &trans        &trans        &trans        &trans        &trans       &trans    &trans    &trans     &trans   &trans    &trans
                                            &kp LGUI        &trans     &kp LSHFT    &kp SPACE    &trans  &kp RALT
            >;
        };
    };
};
